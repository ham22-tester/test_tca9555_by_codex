#include <zephyr/dt-bindings/gpio/gpio.h>
#include <zephyr/dt-bindings/i2c/i2c.h>
#include <zephyr/dt-bindings/pinctrl/nrf-pinctrl.h>

/ {
};

&pinctrl {
    gmk_i2c0_default: gmk_i2c0_default {
        group1 {
            psels = <NRF_PSEL(TWIM_SCL, 1, 4)>,
                    <NRF_PSEL(TWIM_SDA, 1, 6)>;
        };
    };
};

&i2c0 {
    status = "okay";
    pinctrl-0 = <&gmk_i2c0_default>;
    pinctrl-names = "default";
    clock-frequency = <I2C_BITRATE_STANDARD>;
};
